## examples/usb/device/usb_dongle/sdkconfig.defaults
```kconfig
#
# Bluetooth
#
CONFIG_BT_ENABLED=y
CONFIG_BT_CONTROLLER_ONLY=y

#
# TinyUSB Stack
#
CONFIG_TINYUSB=y
CONFIG_TINYUSB_DEBUG_LEVEL=0

#
# TinyUSB task configuration
#
# CONFIG_TINYUSB_NO_DEFAULT_TASK is not set
CONFIG_TINYUSB_TASK_PRIORITY=5
CONFIG_TINYUSB_TASK_STACK_SIZE=4096
# end of TinyUSB task configuration

#
# Descriptor configuration
#
CONFIG_TINYUSB_DESC_USE_ESPRESSIF_VID=y
CONFIG_TINYUSB_DESC_USE_DEFAULT_PID=y
CONFIG_TINYUSB_DESC_BCD_DEVICE=0x0101
CONFIG_TINYUSB_DESC_MANUFACTURER_STRING="Espressif Systems"
CONFIG_TINYUSB_DESC_PRODUCT_STRING="Espressif Device"
CONFIG_TINYUSB_DESC_NET_STRING="Espressif NET Device"
CONFIG_TINYUSB_DESC_BTH_STRING="Espressif BTH Device"
# end of Descriptor configuration

#
# USB Network Class (RNDIS, ECM)
#
CONFIG_TINYUSB_NET_ENABLED=y
CONFIG_TINYUSB_RNDIS_VENDOR="TinyUSB"
CONFIG_TINYUSB_NET_RNDIS=y
# CONFIG_TINYUSB_NET_ECM is not set
# end of USB Network Class (RNDIS, ECM)
# end of TinyUSB Stack

#
# Bluetooth Host Class (BTH)
#
CONFIG_TINYUSB_BTH_ENABLED=y
CONFIG_TINYUSB_BTH_ISO_ALT_COUNT=0
# end of Bluetooth Host Class (BTH)
# end of TinyUSB Stack
```

## examples/usb/device/usb_rndis/sdkconfig.defaults
```kconfig
#
# TinyUSB
#
CONFIG_TINYUSB=y

#
# USB task configuration
#
# CONFIG_USB_DO_NOT_CREATE_TASK is not set
CONFIG_TINYUSB_TASK_PRIORITY=5
# end of USB task configuration

#
# Descriptor configuration
#
CONFIG_TINYUSB_DESC_USE_ESPRESSIF_VID=y
CONFIG_TINYUSB_DESC_USE_DEFAULT_PID=y
CONFIG_TINYUSB_DESC_BCDDEVICE=0x0100
CONFIG_TINYUSB_DESC_MANUFACTURER_STRING="Espressif Systems"
CONFIG_TINYUSB_DESC_PRODUCT_STRING="Espressif Device"
CONFIG_TINYUSB_DESC_SERIAL_STRING="123456"
CONFIG_TINYUSB_DESC_CDC_STRING="Espressif CDC Device"
# end of Descriptor configuration

# CONFIG_TINYUSB_MSC_ENABLED is not set
CONFIG_TINYUSB_CDC_ENABLED=y
CONFIG_TINYUSB_CDC_PORT_NUM=2
CONFIG_TINYUSB_CDC_RX_BUFSIZE=512
CONFIG_TINYUSB_CDC_TX_BUFSIZE=512
CONFIG_TINYUSB_NET_ENABLED=y
CONFIG_TINYUSB_RNDIS_VENDOR="TinyUSB"
CONFIG_TINYUSB_DEBUG_LEVEL=0
# end of TinyUSB
```
